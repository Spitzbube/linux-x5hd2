## drivers/gpu/arm/Kconfig
```kconfig
config GPU_MALI
	tristate "Mali GPUs support"
	depends on ARM
	default y if ARCH_S40
	default n if ARCH_GODBOX
	select DMA_SHARED_BUFFER
	---help---
	  This enables support for the ARM mali GPUs.

if GPU_MALI
source "drivers/gpu/arm/mali/Kconfig"
endif
```

## drivers/net/ethernet/hieth-gmac/Kconfig
```kconfig
#
# hieth family network device configuration
#

menuconfig HIETH_GMAC
	tristate "hieth gmac family network device support"
#	depends on (ARCH_GODEYES)
	default y

	help
	  This selects the hieth gmac family network device.

if HIETH_GMAC

config HIETH_TAG
	hex "hieth-gmac misc tag"
	default "0x544100ff"
	help
	  This is graceful set phy interface/mdio/phyaddr in kernel.

config ETHADDR_TAG
	hex "hieth-gmac mac address tag"
	default "0x726d6d73"
	help
	  This is graceful set mac address in kernel.

config HIGMAC_IOBASE
	hex "hieth-gmac IO address"
	default "0xf9840000"

config HIGMAC_IRQNUM
	int "hieth-gmac irq number"
	default "103"

config HIGMAC_PHY0_ADDR
	int "hieth-gmac0 phyid"
	range 1 31
	default "1"
	help
	  hieth-gmac phyid addr.

config HIGMAC_PHY1_ADDR
	int "hieth-gmac1 phyid"
	range 1 31
	default "2"
	help
	  hieth-gmac phyid addr.

config HIGMAC_MAX_QUEUE_DEPTH
	int "hieth-gmac max hardware queue depth"
	range 1 65535
	default "1024"
	help
	  This option limit the scope of hardware queue.

config HIGMAC_HWQ_RX_FQ_DEPTH
	int "hieth-gmac hareware rx free queue depth"
	range 1 65535
	default "256"
	help
	  This option optimize RX performance.
	  Default is 256.
	  This option can't larger than CONFIG_HIGMAC_MAX_QUEUE_DEPTH.

config HIGMAC_HWQ_RX_BQ_DEPTH
	int "hieth-gmac hareware rx busy queue depth"
	range 1 65535
	default "544"
	help
	  This option optimize RX performance.
	  Default is 544.
	  This option can't larger than CONFIG_HIGMAC_MAX_QUEUE_DEPTH.

config HIGMAC_HWQ_TX_BQ_DEPTH
	int "hieth-gmac hareware tx busy queue depth"
	range 1 65535
	default "512"
	help
	  This option optimize TX performance.
	  Default is 512.
	  This option can't larger than CONFIG_HIGMAC_MAX_QUEUE_DEPTH.

config HIGMAC_HWQ_TX_RQ_DEPTH
	int "hieth-gmac hareware tx release queue depth"
	range 1 65535
	default "1056"
	help
	  This option optimize TX performance.
	  Default is 1056.
	  This option can't larger than CONFIG_HIGMAC_MAX_QUEUE_DEPTH.

endif # HIETH_GMAC
```

## drivers/usb/host/Kconfig.s40
```kconfig
#
# hiusb Host Controller Drivers
#
comment "hiusb Host Controller Drivers"
	depends on USB

menuconfig HIUSB_HOST
	bool "hiusb(xhci/ehci/ohci) family usb host device support"
	default y 
	help
	  This selects the usb(xhci/ehci/ohci) family usb host device.

if HIUSB_HOST

config HIUSB_XHCI
	bool "hiusb-xhci usb host device support"
	default y 

config HIUSB_XHCI_IOBASE
	hex "hiusb-xhci IO address"
	default "0xf98a0000" 

config HIUSB_XHCI_IOSIZE
	hex "hiusb-xhci IO size"
	default "0x00010000"
	help
	  default is 0x10000.

config HIUSB_XHCI_IRQNUM
	int "hiusb-xhci irq number"
	default "101" 

config HIUSB_EHCI
	bool "hiusb-ehci usb host device support"
	default y 

config HIUSB_EHCI_IOBASE
	hex "hiusb-ehci IO address"
	default "0xf9890000" 

config HIUSB_EHCI_IOSIZE
	hex "hiusb-ehci IO size"
	default "0x00010000"
	help
	  default is 0x10000.

config HIUSB_EHCI_IRQNUM
	int "hiusb-ehci irq number"
	default "98" 

config HIUSB_OHCI
	bool "hiusb-ohci usb host device support"
	default y 

config HIUSB_OHCI_IOBASE
	hex "hiusb-ohci IO address"
	default "0xf9880000" 

config HIUSB_OHCI_IOSIZE
	hex "hiusb-ohci IO size"
	default "0x00010000"
	help
	  default is 0x10000.

config HIUSB_OHCI_IRQNUM
	int "hiusb-ohci irq number"
	default "99" 

config HIUSB_OTG
	tristate "hiusb USB2.0 host/device otg support"
	select HI_HS_DEVICE
	help
	  This driver enables PORT0 with otg function.

if HIUSB_OTG
config HIUSB_OTG_SWITCH_TIME
	int "host/device detection interval(ms)"
	default "1000" 
	help
	  host/device detection interval

endif # HIUSB_OTG

endif # HIUSB_HOST
```
